## buildroot-2026.02.1/configs/100ask_imx6ull-pro_defconfig
```kconfig
BR2_arm=y
BR2_cortex_a7=y
BR2_ARM_FPU_NEON_VFPV4=y
BR2_TOOLCHAIN_EXTERNAL=y
BR2_TOOLCHAIN_EXTERNAL_BOOTLIN=y
BR2_TOOLCHAIN_EXTERNAL_BOOTLIN_ARMV7_EABIHF_GLIBC_STABLE=y
BR2_ROOTFS_DEVICE_CREATION_DYNAMIC_EUDEV=y
BR2_TARGET_GENERIC_GETTY_PORT="ttymxc0"
BR2_ROOTFS_OVERLAY="board/100ask/imx6ull-pro/rootfs-overlay"
BR2_GLOBAL_PATCH_DIR="board/100ask/imx6ull-pro/patches"
BR2_ROOTFS_POST_IMAGE_SCRIPT="board/freescale/common/imx/post-image.sh"
BR2_LINUX_KERNEL=y
BR2_LINUX_KERNEL_CUSTOM_GIT=y
BR2_LINUX_KERNEL_CUSTOM_REPO_URL="https://gitee.com/weidongshan/linux-imx.git"
BR2_LINUX_KERNEL_CUSTOM_REPO_VERSION="05967a3aaba135f40eee6eaf14ced11c090d32c1"
BR2_LINUX_KERNEL_DEFCONFIG="imx_v7"
BR2_LINUX_KERNEL_CONFIG_FRAGMENT_FILES="board/100ask/imx6ull-pro/linux-fragment.config"
BR2_LINUX_KERNEL_DTS_SUPPORT=y
BR2_LINUX_KERNEL_INTREE_DTS_NAME="imx6ull-14x14-evk"
BR2_LINUX_KERNEL_NEEDS_HOST_OPENSSL=y
BR2_PACKAGE_FREESCALE_IMX=y
BR2_PACKAGE_FREESCALE_IMX_PLATFORM_IMX6UL=y
BR2_PACKAGE_FIRMWARE_IMX=y
BR2_TARGET_ROOTFS_EXT2=y
BR2_TARGET_ROOTFS_EXT2_4=y
BR2_TARGET_UBOOT=y
BR2_TARGET_UBOOT_BOARDNAME="mx6ull_14x14_evk_emmc"
BR2_TARGET_UBOOT_CUSTOM_GIT=y
BR2_TARGET_UBOOT_CUSTOM_REPO_URL="https://gitee.com/weidongshan/uboot-imx.git"
BR2_TARGET_UBOOT_CUSTOM_REPO_VERSION="65baaf3fb37946b98d7c85ad5e014f9389d580a4"
BR2_TARGET_UBOOT_NEEDS_DTC=y
BR2_TARGET_UBOOT_NEEDS_OPENSSL=y
BR2_TARGET_UBOOT_NEEDS_GNUTLS=y
BR2_TARGET_UBOOT_FORMAT_DTB_IMX=y
BR2_PACKAGE_HOST_DOSFSTOOLS=y
BR2_PACKAGE_HOST_GENIMAGE=y
BR2_PACKAGE_HOST_MTOOLS=y
BR2_PACKAGE_SL=y
BR2_PACKAGE_HTOP=y
BR2_PACKAGE_LVGL9_DEMO=y
BR2_PACKAGE_HELLO_APP=y
```

## buildroot-2026.02.1/package/hello-app/Config.in
```kconfig
config BR2_PACKAGE_HELLO_APP
	bool "hello-app"
	help
	  Build and install a minimal hello.c sample program.
```

## buildroot-2026.02.1/package/lvgl9-demo/Config.in
```kconfig
config BR2_PACKAGE_LVGL9_DEMO
	bool "lvgl9-demo"
	help
	  LVGL9 framebuffer preview demo for Linux fbdev/evdev.

	  This package builds a lightweight LVGL9 demo application and
	  installs it as /usr/bin/lvgl9-demo.

	  https://github.com/lvgl/lvgl
```

## buildroot-2026.02.1/package/mqtt-demo/Config.in
```kconfig
config BR2_PACKAGE_MQTT_DEMO
	bool "mqtt-demo"
	depends on BR2_USE_MMU
	depends on !BR2_STATIC_LIBS
	select BR2_PACKAGE_MOSQUITTO
	select BR2_PACKAGE_MOSQUITTO_BROKER
	help
	  Build and install a minimal MQTT loopback demo program.
	  The demo connects to the local mosquitto broker, subscribes
	  to a topic, publishes a test message, and verifies the
	  loopback result on the target board.

comment "mqtt-demo needs a toolchain w/ dynamic library"
	depends on BR2_STATIC_LIBS
```
